## firmware/components/mqtt_svc/Kconfig.projbuild
```kconfig
menu "mqtt_svc Configuration"

    config MQTT_SVC_BROKER_URI
        string "MQTT Broker Uri"
        default "local.mybrokeruri"
        help
            Uri of the broker that the esp shall connect to within the network.
            Of form "mqtt://<hostname>.local:<port>".

    config MQTT_SVC_USERNAME
        string "MQTT Username"
        default ""
        help
            Username of the MQTT client used for authentication.
            Empty connects anonymously.

    config MQTT_SVC_PASSWORD
        string "MQTT Password"
        default ""
        help
            MQTT password used to authenticate at the broker.
            Empty sends no password.

    config MQTT_SVC_MAX_SUBSCRIPTIONS
        int "Maximum subscriptions"
        default 8
        range 1 64
        help
            Number of topic filters that can be subscribed at the same time.

    config MQTT_SVC_REPORT_EXPIRED
        bool "Report expired messages"
        default y
        select MQTT_REPORT_DELETED_MESSAGES
        help
            Enables esp-mqtt's MQTT_EVENT_DELETED for QoS 1 and 2 messages that expire in the
            outbox without an acknowledgement. Without it, on_delivery never reports a failure
            and mqtt_svc_flush cannot tell an expired message from a delivered one.
endmenu
```

## firmware/components/wlink/Kconfig.projbuild
```kconfig
menu "wlink Station Configuration"

    config WLINK_STA_SSID
        string "Wi-Fi SSID"
        default "myssid"
        help
            SSID (network name) of the access point to connect to.

    config WLINK_STA_PASSWORD
        string "Wi-Fi Password"
        default "mypassword"
        help
            WPA2 password of the access point. Leave empty for an open network.

endmenu
```

## firmware/main/Kconfig.projbuild
```kconfig
menu "Display Configuration"

    config DISPLAY_PIN_SDA
        int "I2C SDA GPIO"
        default 25
        help
            GPIO the display's SDA line is wired to.

    config DISPLAY_PIN_SCL
        int "I2C SCL GPIO"
        default 26
        help
            GPIO the display's SCL line is wired to.

    config DISPLAY_I2C_ADDR
        hex "I2C address"
        default 0x3C
        range 0x08 0x77
        help
            7-bit I2C address of the SSD1306, usually 0x3C, sometimes 0x3D.

endmenu
```
